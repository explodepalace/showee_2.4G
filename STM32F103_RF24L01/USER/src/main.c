/**
  ******************************************************************************
  * @author  泽耀科技 ASHINING
  * @version V3.0
  * @date    2016-10-08
  * @brief   主函数C文件
  ******************************************************************************
  * @attention
  *
  * 官网	:	http://www.ashining.com
  * 淘宝	:	https://shop105912646.taobao.com
  * 阿里巴巴:	https://cdzeyao.1688.com
  ******************************************************************************
  */



#include "main.h"				//main.h 中含有TX/RX、软件SPI/硬件SPI选择配置选项


const char *g_Ashining = "ashining";
uint8_t g_TxMode = 0, g_UartRxFlag = 0;
uint8_t g_UartRxBuffer[ 100 ] = { 0 };
uint8_t g_RF24L01RxBuffer[ 32 ] = { 0 }; 



/**
  * @brief :主函数 
  * @param :无
  * @note  :无
  * @retval:无
  */ 
int main( void )
{	
	uint8_t i = 0;

	//串口初始化
	drv_uart_init( 115200 );
	drv_uart3_init( 115200 );

	//延时初始化
	drv_delay_init( );
	
	//LED初始化
	drv_led_init( );
	
	//SPI初始化
	drv_spi_init( );
	
	//RF24L01引脚初始化
	NRF24L01_Gpio_Init( );
	
	//检测nRF24L01
	NRF24L01_check( );			
	RF24L01_Init( );
	
	led_off( );
	for( i = 0; i < 6; i++ )
	{
		led_flash_fast( );
		drv_delay_500Ms( 1 );
	}
		
	
#ifdef	__RF24L01_TX_TEST__		
//=========================================================================================//	
//*****************************************************************************************//
//************************************* 发送 **********************************************//
//*****************************************************************************************//
//=========================================================================================//	
	drv_uart3_printf("Tx mode!!!");
	//按键初始化
	drv_button_init( );
	
	RF24L01_Set_Mode( MODE_TX );		//发送模式
	while( 1 )	
	{		
		//发送
//		if( TX_MODE_1 == g_TxMode )
//		{
//			NRF24L01_TxPacket( (uint8_t *)g_Ashining, 8 );
//			drv_delay_500Ms( 1 );
//			drv_delay_500Ms( 1 );
//			led_flash_fast( );
//		}
//		else
		{
			i = drv_uart_rx_bytes( g_UartRxBuffer );

			if( 0 != i )
			{
				NRF24L01_TxPacket( g_UartRxBuffer, i );
				led_flash_fast( );
			}
		}
	}
	
#else		
//=========================================================================================//	
//*****************************************************************************************//
//************************************* 接收 **********************************************//
//*****************************************************************************************//
//=========================================================================================//	
	drv_uart3_printf("Rx mode!!!");
	RF24L01_Set_Mode( MODE_RX );		//接收模式
	while( 1 )
	{
		i = NRF24L01_RxPacket( g_RF24L01RxBuffer );
		if( 0 != i )
		{
			led_flash_slow( );
			drv_uart_tx_bytes( g_RF24L01RxBuffer, i );
		}
	}
		

	
#endif
	
}

